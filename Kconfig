## Kconfig
```kconfig
menu "KeeMASH Reliable Mesh"

    config KEEMASH_V2_COMPAT_TUNNEL_ENABLE
        bool "Enable pre-lossless V2 tunnel compatibility"
        default y
        help
            Keep parsing and transmitting the older V2 tunnel profile for
            legacy peers. Disable on nodes paired exclusively with a lossless
            root so transient reliable errors never downgrade transport.

    config KEEMASH_REL_INITIAL_RTO_MS
        int "Initial retransmission timeout (ms)"
        range 500 5000
        default 1500

    config KEEMASH_REL_MIN_RTO_MS
        int "Minimum retransmission timeout (ms)"
        range 250 5000
        default 500

    config KEEMASH_REL_MAX_RTO_MS
        int "Maximum retransmission timeout (ms)"
        range 1000 10000
        default 5000

    config KEEMASH_REL_MAX_RETRIES
        int "Maximum retransmissions"
        range 1 10
        default 5

    config KEEMASH_REL_FRAGMENT_TIMEOUT_MS
        int "Fragment reassembly timeout (ms)"
        range 1000 60000
        default 10000

    config KEEMASH_REL_ROUTE_GRACE_MS
        int "Route outage replay retention (ms)"
        range 5000 300000
        default 90000

    config KEEMASH_REL_STALE_PEER_MS
        int "Offline peer eviction age (ms)"
        range 60000 3600000
        default 300000

    config KEEMASH_ACTIVE_PING_PERIOD_MS
        int "Active peer ping period (ms)"
        range 1000 60000
        default 5000
        help
            Send one best-effort application PING to one peer per period.
            PING/PONG diagnostics do not consume replay slots or affect LOST.

    config KEEMASH_ACTIVE_PING_TIMEOUT_MS
        int "Active peer ping timeout (ms)"
        range 500 30000
        default 4000

    config KEEMASH_REL_FAULT_DROP_DATA_EVERY
        int "Debug: drop every Nth reliable DATA packet"
        range 0 10000
        default 0

    config KEEMASH_REL_FAULT_DROP_ACK_EVERY
        int "Debug: drop every Nth reliable ACK packet"
        range 0 10000
        default 0

    config KEEMASH_REL_FAULT_DROP_NACK_EVERY
        int "Debug: drop every Nth reliable NACK packet"
        range 0 10000
        default 0

    config KEEMASH_REL_FAULT_DUPLICATE_EVERY
        int "Debug: duplicate every Nth reliable DATA packet"
        range 0 10000
        default 0

    config KEEMASH_REL_FAULT_DELAY_EVERY
        int "Debug: delay every Nth reliable DATA packet"
        range 0 10000
        default 0

    config KEEMASH_REL_FAULT_DELAY_MS
        int "Debug: injected DATA delay (ms)"
        range 1 10000
        default 250

    config KEEMASH_REL_FAULT_REORDER_EVERY
        int "Debug: reorder every Nth reliable DATA packet"
        range 0 10000
        default 0

    config KEEMASH_REL_FAULT_OVERFLOW_EVERY
        int "Debug: force overflow for every Nth message"
        range 0 10000
        default 0

    config KEEMASH_NODE_PSRAM_EXPECTED_BYTES
        int "Expected node PSRAM capacity when PSRAM is disabled"
        range 0 16777216
        default 0
        help
            Used by the generic typed memory telemetry helper when PSRAM is
            not active but the board definition wants to advertise possible
            PSRAM capacity. Leave 0 when unknown.

    config KEEMASH_NODE_TASK_SLOTS
        int "Maximum tasks in a typed TASK snapshot"
        range 16 64
        default 48
        help
            FreeRTOS returns no task snapshot when the supplied status array
            is smaller than the current task count. Keep enough headroom for
            sensor-rich nodes while bounding static RAM usage.

    config KEEMASH_NODE_V2_LOG_ENABLE
        bool "Use reliable V2 for node log streaming"
        default y
        help
            Send captured node logs through the reliable LOG channel. A V1
            fallback is considered only when compatibility support is enabled.

    config KEEMASH_V1_PRENEGOTIATION_ENABLE
        bool "Allow V1 node telemetry before lossless negotiation"
        default y
        help
            Emit V1 NODEINFO and LOG packets only while the current root has
            not completed a reliable lossless handshake. Once negotiated, the
            node keeps the lossless transport sticky until reboot or an
            explicit root identity change.

    config KEEMASH_LOG_CAPTURE_QUEUE_LEN
        int "Captured log queue entries"
        range 8 128
        default 32
        help
            Fixed number of preallocated log lines waiting for the dedicated
            reliable LOG worker. Overflow is reported explicitly.

    config KEEMASH_LOG_CAPTURE_LINE_MAX
        int "Captured log line bytes"
        range 128 512
        default 256

    config KEEMASH_NODEINFO_PERIOD_MS
        int "Node heartbeat period (ms)"
        range 5000 300000
        default 15000

endmenu
```

## examples/ota_v3_compile_probe/sdkconfig.defaults
```kconfig
CONFIG_IDF_TARGET="esp32s3"
CONFIG_KEEMASH_OTA_V3_ENABLE=y
CONFIG_KEEMASH_OTA_V3_TRUSTED_P256_PUBKEY_HEX="046b17d1f2e12c4247f8bce6e563a440f277037d812deb33a0f4a13945d898c2964fe342e2fe1a7f9b8ee7eb4a7c0f9e162bce33576b315ececbb6406837bf51f5"
```
